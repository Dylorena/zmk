## app/dts/bindings/behaviors/behavior-cmd.yaml
```yaml
description: Behavior command for studio unlock
compatible: "zmk,behavior-cmd"

include: one_param.yaml

properties:
  label:
    type: string
    required: true
```
